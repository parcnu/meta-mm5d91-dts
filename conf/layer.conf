## conf/layer.conf
```bitbake
# We have a conf and classes directory, add to BBPATH
BBPATH .= ":${LAYERDIR}"

# We have recipes-* directories, add to BBFILES
BBFILES += "${LAYERDIR}/recipes-*/*/*.bb \
            ${LAYERDIR}/recipes-*/*/*.bbappend"

BBFILE_COLLECTIONS += "meta-mm5d91-dts"
BBFILE_PATTERN_meta-mm5d91-dts = "^${LAYERDIR}/"
BBFILE_PRIORITY_meta-mm5d91-dts = "6"

LAYERDEPENDS_meta-mm5d91-dts = "core"
LAYERSERIES_COMPAT_meta-mm5d91-dts = "scarthgap styhead kirkstone"

KERNEL_DEVICETREE:append = " overlays/mm5d91.dtbo" 
```
